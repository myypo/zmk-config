#include <behaviors.dtsi>
#include <behaviors/num_word.dtsi> // requires auto-layer module
#include <dt-bindings/zmk/keys.h>
#ifdef CONFIG_WIRELESS
    #include <dt-bindings/zmk/bt.h>
    #include <dt-bindings/zmk/outputs.h>
    #define _BT_SEL_KEYS_ &bt BT_SEL 0 &bt BT_SEL 1 &bt BT_SEL 2 &bt BT_SEL 3 &bt BT_CLR
#else
    #define _BT_SEL_KEYS_ &trans &trans &trans &trans &trans
#endif

#include "zmk-helpers/helper.h"

#include "keys_uk_enhanced.h"

#define DEF 0
#define UKR 1
#define NAV 2
#define SYM 3
#define FN 4
#define SYS 5
#define MOUSE 6

#define XXX &none
#define ___ &trans

/* Global settings */

#define QUICK_TAP_MS 175

&sk {  // sticky-key config
    release-after-ms = <900>;  // release after 0.9s
    quick-release;             // no double capitalization when rolling keys
};

&sl {  // sticky-layer config
    ignore-modifiers;          // allow chording sticky mods & layers
};

&lt {  // layer-tap config
    flavor = "balanced";
    tapping-term-ms = <200>;
    quick-tap-ms = <QUICK_TAP_MS>;
};

/* Homerow mods */

#define KEYS_L LT0 LT1 LT2 LT3 LT4 LM0 LM1 LM2 LM3 LM4 LB0 LB1 LB2 LB3 LB4  // left hand
#define KEYS_R RT0 RT1 RT2 RT3 RT4 RM0 RM1 RM2 RM3 RM4 RB0 RB1 RB2 RB3 RB4  // right hand
#ifndef LH2
    #define THUMBS LH1 LH0 RH0 RH1                                          // thumbs on 34 keys
#else
    #define THUMBS LH2 LH1 LH0 RH0 RH1 RH2                                  // thumbs on 36+ keys
#endif

#define MAKE_HRM(NAME, HOLD, TAP, TRIGGER_POS) \
    ZMK_HOLD_TAP(NAME, \
        flavor = "balanced"; \
        tapping-term-ms = <400>; \
        quick-tap-ms = <QUICK_TAP_MS>; \
        require-prior-idle-ms = <200>; \
        bindings = <HOLD>, <TAP>; \
        hold-trigger-key-positions = <TRIGGER_POS>; \
        hold-trigger-on-release; \
    )
MAKE_HRM(hml, &kp, &kp, KEYS_R THUMBS)  // left-hand HRMs
MAKE_HRM(hmr, &kp, &kp, KEYS_L THUMBS)  // right-hand HRMs

// HRM combo hack - workaround for lack of tap-only combos (ZMK issue #544)
#define ZMK_COMBO_8(NAME, TAP, KEYPOS, LAYERS, COMBO_TERM, COMBO_IDLE, HOLD, SIDE) \
    MAKE_HRM(hm_combo_ ## NAME, &kp, TAP, SIDE THUMBS) \
    ZMK_COMBO_6(NAME, &hm_combo_ ## NAME HOLD 0, KEYPOS, LAYERS, COMBO_TERM, COMBO_IDLE)

/* Combos, mouse emulation */

#include "combos.dtsi"  // must be sourced after HRM-combo hack
#include "mouse.dtsi"
#include "extra_keys.h"

/* Caps-word, and smart-mouse */

&caps_word {  
    /delete-property/ ignore-modifiers; // mods deactivate caps-word, requires PR #1451
    continue-list = <BSPC DEL UNDER MINUS COMMA DOT DQT SQT>;
    mods = <MOD_LSFT>;
};
// TODO: I don't know how else to cancel the sticky layer here
ZMK_MACRO(swallow_caps_word,
    bindings = <&kp F22 &caps_word>;
)
#define CAPS_WORD &swallow_caps_word

/* Custom behaviors */
/ {
  behaviors {
    sym_word: sym_word {
      compatible = "zmk,behavior-auto-layer";
      #binding-cells = <1>;
      continue-list = <BSLH PRCNT DLLR HASH UNDER SEMI COLON EQUAL GRAVE AT MINUS TILDE PLUS EXCL AMPS PIPE CARET LPAR LBRC LBKT STAR RPAR RBRC RBKT>;
    };
  };
};

/ {
  behaviors {
    num_word: num_word {
      compatible = "zmk,behavior-auto-layer";
      #binding-cells = <1>;
      continue-list = <N0 N1 N2 N3 N4 N5 N6 N7 N8 N9 BSPC COMMA DOT FSLH PLUS MINUS UNDER>;
    };
  };
};

// reuse basic mod-morph scheme
#define SIMPLE_MORPH(NAME, MOD, BINDING1, BINDING2) \
    ZMK_MOD_MORPH(NAME, \
        mods = <(MOD_L ## MOD|MOD_R ## MOD)>; \
        bindings = <BINDING1>, <BINDING2>; \
    )

/* Nav cluster */

SIMPLE_MORPH(nav_left, ALT, &kp LEFT, &kp HOME)
SIMPLE_MORPH(nav_right, ALT, &kp RIGHT, &kp END)
SIMPLE_MORPH(nav_up, ALT, &kp PG_UP, &kp LC(HOME))
SIMPLE_MORPH(nav_down, ALT, &kp PG_DN, &kp LC(END))
#define NAV_LEFT  &nav_left
#define NAV_RIGHT &nav_right   
#define NAV_UP    &nav_up
#define NAV_DOWN  &nav_down

// TODO: I don't know how else to cancel the sticky shift here
ZMK_MACRO(swallow_num_word,
    bindings = <&kp F22 &num_word NAV>;
)

/* Symbol cluster */

// TODO: I don't know how else to cancel the sticky shift here
ZMK_MACRO(swallow_sym_word,
    bindings = <&kp F22 &sym_word SYM>;
)
// tap: sticky-sym | shift + tap: sym-word | hold: sym
SIMPLE_MORPH(smart_sym, SFT, &sl SYM, &lt SYM &swallow_sym_word)

/* Other */

#define CANCEL      &kp K_CANCEL             // cancel caps-word, num-word and smart-mouse

// tap: backspace | shift + tap: delete
SIMPLE_MORPH(bsdl, SFT, &kp BSPC, &kp DEL)

// tap: " | shift + tap: '
SIMPLE_MORPH(dsqt, SFT, &kp DQT, &kp SQT)

SIMPLE_MORPH(nav_spc, SFT, &lt NAV SPACE, &lt NAV &swallow_num_word)

/* Conditional layers */

ZMK_CONDITIONAL_LAYER(sys, FN NAV, SYS)  // FN + NAV --> SYS

// smart-mouse, requires PR #1366
ZMK_TRI_STATE(smart_mouse,
    bindings = <&tog MOUSE>, <&none>, <&tog MOUSE>;
    ignored-key-positions = <RT1 RT2 RT3 RM1 RM2 RM3 RH0 RH1>;
    ignored-layers = <MOUSE>;
)

/* Ukrainian language */

#define CYR_EF       &kp UK_CYRILLIC_EF
#define CYR_VE       &kp UK_CYRILLIC_VE
#define CYR_YA       &kp UK_CYRILLIC_YA
#define CYR_PE       &kp UK_CYRILLIC_PE
#define CYR_BE       &kp UK_CYRILLIC_BE
#define CYR_SHORT_I  &kp UK_CYRILLIC_SHORT_I
#define CYR_EL       &kp UK_CYRILLIC_EL
#define CYR_U        &kp UK_CYRILLIC_U
#define CYR_I        &kp UK_CYRILLIC_I
#define UKR_IE       &kp UK_UKRAINIAN_IE
#define CYR_A        &kp UK_CYRILLIC_A
#define CYR_ER       &hml LALT UK_CYRILLIC_ER
#define CYR_ES       &hml LGUI UK_CYRILLIC_ES
#define CYR_TE       &hml LCTRL UK_CYRILLIC_TE
#define CYR_GHE      &kp UK_CYRILLIC_GHE
#define CYR_EM       &kp UK_CYRILLIC_EM
#define CYR_EN       &hmr LCTRL UK_CYRILLIC_EN
#define CYR_IE       &hmr LGUI UK_CYRILLIC_IE
#define UKR_I        &hmr LALT UK_UKRAINIAN_I
#define CYR_O        &kp UK_CYRILLIC_O
#define CYR_ZE       &kp UK_CYRILLIC_ZE
#define CYR_SOFT     &kp UK_CYRILLIC_SOFT_SIGN
#define CYR_TSE      &kp UK_CYRILLIC_TSE
#define CYR_DE       &kp UK_CYRILLIC_DE
#define CYR_YU       &kp UK_CYRILLIC_YU
#define CYR_KA       &kp UK_CYRILLIC_KA
#define CYR_CHE      &kp UK_CYRILLIC_CHE
#define CYR_YI       &kp UK_CYRILLIC_YI

ZMK_MACRO(ukr_eng, 
    bindings = 
        <&macro_press &tog UKR &kp LALT>,
        <&macro_tap &kp RALT>,
        <&macro_pause_for_release>,
        <&macro_release &tog UKR &kp LALT>;
)
SIMPLE_MORPH(comma_sha, SFT, &kp UK_COMMA, &kp UK_CYRILLIC_SHA)
SIMPLE_MORPH(dot_shcha, SFT, &kp UK_PERIOD, &kp UK_CYRILLIC_SHCHA)
SIMPLE_MORPH(yi_qmark, SFT, CYR_YI, &kp UK_QMARK)
SIMPLE_MORPH(ie_sqt, SFT, UKR_IE, &kp UK_SQT)


/* Keymap */

ZMK_LAYER(base,
//╭──────╮ ╭─────────────┬─────────────┬─────────────┬─────────────┬─────────────╮ ╭──────╮ ╭─────────────┬─────────────┬─────────────┬─────────────┬─────────────╮ ╭──────╮
    X_LT     &kp Q         &kp W         &kp F         &kp P         &kp B           X_MT     &kp J         &kp L         &kp U         &kp Y         &dsqt           X_RT
//├──────┤ ├─────────────┼─────────────┼─────────────┼─────────────┼─────────────┤ ├──────┤ ├─────────────┼─────────────┼─────────────┼─────────────┼─────────────┤ ├──────┤
    X_LM     &kp A         &hml LALT R   &hml LGUI S   &hml LCTRL T  &kp G           X_MM     &kp M         &hmr LCTRL N  &hmr LGUI E   &hmr LALT I   &kp O           X_RM
//├──────┤ ├─────────────┼─────────────┼─────────────┼─────────────┼─────────────┤ ├──────┤ ├─────────────┼─────────────┼─────────────┼─────────────┼─────────────┤ ├──────┤
    X_LB     &kp Z         &kp X         &kp C         &kp D         &kp V           X_MB     &kp K         &kp H         &kp COMMA     &kp DOT       &kp FSLH        X_RB
//├──────┤ ╰─────────────┼─────────────┴─────────────┼─────────────┼─────────────┤ ├──────┤ ├─────────────┼─────────────┼─────────────┴───────────────────────────╯ ├──────┤
    X_LH                                               &lt FN RET    &sk LSHFT       X_MH     &smart_sym    &nav_spc                                                  X_RH
//╰──────╯                                           ╰─────────────┴─────────────╯ ╰──────╯ ╰─────────────┴─────────────╯                                           ╰──────╯
)

ZMK_LAYER(ukr,
//╭──────╮ ╭─────────────┬─────────────┬─────────────┬─────────────┬─────────────╮ ╭──────╮ ╭─────────────┬─────────────┬─────────────┬─────────────┬─────────────╮ ╭──────╮
    X_LT     CYR_EF        CYR_VE        CYR_YA        CYR_PE        CYR_BE          X_MT     CYR_SHORT_I   CYR_EL        CYR_U         CYR_I         &ie_sqt         X_RT
//├──────┤ ├─────────────┼─────────────┼─────────────┼─────────────┼─────────────┤ ├──────┤ ├─────────────┼─────────────┼─────────────┼─────────────┼─────────────┤ ├──────┤
    X_LM     CYR_A         CYR_ER        CYR_ES        CYR_TE        CYR_GHE         X_MM     CYR_EM        CYR_EN        CYR_IE        UKR_I         CYR_O           X_RM
//├──────┤ ├─────────────┼─────────────┼─────────────┼─────────────┼─────────────┤ ├──────┤ ├─────────────┼─────────────┼─────────────┼─────────────┼─────────────┤ ├──────┤
    X_LB     CYR_ZE        CYR_SOFT      CYR_TSE       CYR_DE        CYR_YU          X_MB     CYR_KA        CYR_CHE       &comma_sha    &dot_shcha    &yi_qmark       X_RB
//├──────┤ ╰─────────────┼─────────────┴─────────────┼─────────────┼─────────────┤ ├──────┤ ├─────────────┼─────────────┼─────────────┴───────────────────────────╯ ├──────┤
    X_LH                                               ___           ___             X_MH     ___           ___                                                       X_RH
//╰──────╯                                           ╰─────────────┴─────────────╯ ╰──────╯ ╰─────────────┴─────────────╯                                           ╰──────╯
)

ZMK_LAYER(nav,
//╭──────╮ ╭─────────────┬─────────────┬─────────────┬─────────────┬─────────────╮ ╭──────╮ ╭─────────────┬─────────────┬─────────────┬─────────────┬─────────────╮ ╭──────╮
    X_LT     ___           &kp N6        &kp N5        &kp N4        ___             X_MT     ___           ___           ___           ___           ___             X_RT
//├──────┤ ├─────────────┼─────────────┼─────────────┼─────────────┼─────────────┤ ├──────┤ ├─────────────┼─────────────┼─────────────┼─────────────┼─────────────┤ ├──────┤
    X_LM     &kp N0        &hml LALT N3  &hml LGUI N2  &hml LCTRL N1 ___             X_MM     NAV_LEFT      &kp DOWN      &kp UP        NAV_RIGHT     ___             X_RM
//├──────┤ ├─────────────┼─────────────┼─────────────┼─────────────┼─────────────┤ ├──────┤ ├─────────────┼─────────────┼─────────────┼─────────────┼─────────────┤ ├──────┤
    X_LB     ___           &kp N9        &kp N8        &kp N7        ___             X_MB     ___           ___           ___           ___           ___             X_RB
//├──────┤ ╰─────────────┼─────────────┴─────────────┼─────────────┼─────────────┤ ├──────┤ ├─────────────┼─────────────┼─────────────┴───────────────────────────╯ ├──────┤
    X_LH                                               ___           ___             X_MH     ___           CANCEL                                                    X_RH
//╰──────╯                                           ╰─────────────┴─────────────╯ ╰──────╯ ╰─────────────┴─────────────╯                                           ╰──────╯
)

ZMK_LAYER(sym,
//╭──────╮ ╭─────────────┬─────────────┬─────────────┬─────────────┬─────────────╮ ╭──────╮ ╭─────────────┬─────────────┬─────────────┬─────────────┬─────────────╮ ╭──────╮
    X_LT     &kp BSLH      &kp PRCNT     &kp DLLR      &kp HASH      ___             X_MT     ___           &kp EXCL      &kp AMPS      &kp PIPE      &kp CARET       X_RT
//├──────┤ ├─────────────┼─────────────┼─────────────┼─────────────┼─────────────┤ ├──────┤ ├─────────────┼─────────────┼─────────────┼─────────────┼─────────────┤ ├──────┤
    X_LM     &kp UNDER     &kp SEMI      &kp COLON     &kp EQUAL     &kp GRAVE       X_MM     &kp PLUS      &kp LPAR      &kp LBRC      &kp LBKT      &kp STAR        X_RM
//├──────┤ ├─────────────┼─────────────┼─────────────┼─────────────┼─────────────┤ ├──────┤ ├─────────────┼─────────────┼─────────────┼─────────────┼─────────────┤ ├──────┤
    X_LB     ___           &kp AT        &kp MINUS     &kp TILDE     ___             X_MB     ___           &kp RPAR      &kp RBRC      &kp RBKT      ___             X_RB
//├──────┤ ╰─────────────┼─────────────┴─────────────┼─────────────┼─────────────┤ ├──────┤ ├─────────────┼─────────────┼─────────────┴───────────────────────────╯ ├──────┤
    X_LH                                               ___           CAPS_WORD       X_MH     CANCEL        ___                                                       X_RH
//╰──────╯                                           ╰─────────────┴─────────────╯ ╰──────╯ ╰─────────────┴─────────────╯                                           ╰──────╯
)

ZMK_LAYER(fn,
//╭──────╮ ╭─────────────┬─────────────┬─────────────┬─────────────┬─────────────╮ ╭──────╮ ╭─────────────┬─────────────┬─────────────┬─────────────┬─────────────╮ ╭──────╮
    X_LT     &kp F11       &kp F6        &kp F5        &kp F4        ___             X_MT     ___           &kp C_MUTE    &kp C_VOL_DN  &kp C_VOL_UP  ___             X_RT
//├──────┤ ├─────────────┼─────────────┼─────────────┼─────────────┼─────────────┤ ├──────┤ ├─────────────┼─────────────┼─────────────┼─────────────┼─────────────┤ ├──────┤
    X_LM     &kp F10       &kp F3        &kp F2        &kp F1        ___             X_MM     ___           NAV_DOWN      NAV_UP        ___           ___             X_RM
//├──────┤ ├─────────────┼─────────────┼─────────────┼─────────────┼─────────────┤ ├──────┤ ├─────────────┼─────────────┼─────────────┼─────────────┼─────────────┤ ├──────┤
    X_LB     &kp F12       &kp F9        &kp F8        &kp F7        ___             X_MB     ___           &kp C_PP      &kp C_PREV    &kp C_NEXT    ___             X_RB
//├──────┤ ╰─────────────┼─────────────┴─────────────┼─────────────┼─────────────┤ ├──────┤ ├─────────────┼─────────────┼─────────────┴───────────────────────────╯ ├──────┤
    X_LH                                               ___           ___             X_MH     ___           ___                                                       X_RH
//╰──────╯                                           ╰─────────────┴─────────────╯ ╰──────╯ ╰─────────────┴─────────────╯                                           ╰──────╯
)

ZMK_LAYER(sys,
//╭──────╮ ╭─────────────┬─────────────┬─────────────┬─────────────┬─────────────╮ ╭──────╮ ╭─────────────┬─────────────┬─────────────┬─────────────┬─────────────╮ ╭──────╮
    X_LT                                _BT_SEL_KEYS_                                X_MT     ___           ___           ___           ___           ___             X_RT
//├──────┤ ├─────────────┼─────────────┼─────────────┼─────────────┼─────────────┤ ├──────┤ ├─────────────┼─────────────┼─────────────┼─────────────┼─────────────┤ ├──────┤
    X_LM     ___           ___           ___           ___           &bootloader     X_MM     &bootloader   ___           ___           ___           ___             X_RM
//├──────┤ ├─────────────┼─────────────┼─────────────┼─────────────┼─────────────┤ ├──────┤ ├─────────────┼─────────────┼─────────────┼─────────────┼─────────────┤ ├──────┤
    X_LB     ___           ___           ___           ___           &sys_reset      X_MB     &sys_reset    ___           ___           ___           ___             X_RB
//├──────┤ ╰─────────────┼─────────────┴─────────────┼─────────────┼─────────────┤ ├──────┤ ├─────────────┼─────────────┼─────────────┴───────────────────────────╯ ├──────┤
    X_LH                                               ___           ___             X_MH     ___           ___                                                       X_RH
//╰──────╯                                           ╰─────────────┴─────────────╯ ╰──────╯ ╰─────────────┴─────────────╯                                           ╰──────╯
)

ZMK_LAYER(mouse,
//╭──────╮ ╭─────────────┬─────────────┬─────────────┬─────────────┬─────────────╮ ╭──────╮ ╭─────────────┬─────────────┬─────────────┬─────────────┬─────────────╮ ╭──────╮
    X_LT     ___           ___           ___           ___           ___             X_MT     ___           &kp PG_UP     U_MS_U         &kp PG_DN    ___             X_RT
//├──────┤ ├─────────────┼─────────────┼─────────────┼─────────────┼─────────────┤ ├──────┤ ├─────────────┼─────────────┼─────────────┼─────────────┼─────────────┤ ├──────┤
    X_LM     ___           ___           ___           ___           ___             X_MM     ___           U_MS_L        U_MS_D         U_MS_R       ___             X_RM
//├──────┤ ├─────────────┼─────────────┼─────────────┼─────────────┼─────────────┤ ├──────┤ ├─────────────┼─────────────┼─────────────┼─────────────┼─────────────┤ ├──────┤
    X_LB     ___           ___           ___           ___           ___             X_MB     ___           ___           ___            ___          ___             X_RB
//├──────┤ ╰─────────────┼─────────────┴─────────────┼─────────────┼─────────────┤ ├──────┤ ├─────────────┼─────────────┼─────────────┴───────────────────────────╯ ├──────┤
    X_LH                                               ___           ___             X_MH     &mkp RCLK     &mkp LCLK                                                 X_RH
//╰──────╯                                           ╰─────────────┴─────────────╯ ╰──────╯ ╰─────────────┴─────────────╯                                           ╰──────╯
)

/* vim: set ft=c tw=174: */
